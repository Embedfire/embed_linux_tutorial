/*
 * Copyright (C) 2019 - All Rights Reserved by 
 * filename : imx-fire-led-overlay.dts
 * brief : Device Tree overlay for EBF6ull led device
 * author : embedfire
 * date : 2019-11-15 
 * version : A001
 */
 /dts-v1/;
 /plugin/;
#include "imx6ul-pinfunc.h"
#include "dt-bindings/gpio/gpio.h"
 / {


		fragment@0 {
			target = <&iomuxc>;
				__overlay__ { 
					pinctrl_18b20: tempgrp {
					fsl,pins = <
						MX6UL_PAD_GPIO1_IO02__GPIO1_IO02	0x10b0	/*ds18b20*/
					>;
				}; 
			};
		};    

		fragment@1 {
			target-path = "/";
			__overlay__ {
				ds18b20 {
					#address-cells = <1>;
					#size-cells = <1>;
					pinctrl-names = "default";
					compatible = "fire,temp_ds18b20";
                    linux,open-drain;
					pinctrl-0 = <&pinctrl_18b20>;
					ds18b20_pin = <&gpio1 2 GPIO_ACTIVE_HIGH>;	/*ds18b20 pin*/
					status = "okay";
				};
			};
		};
 };
