/*
 * Copyright (C) 2019 - All Rights Reserved by 
 * filename : imx-fire-mpu6050-overlay.dts
 * brief : Device Tree overlay for EBF6ull Pro mpu6050 device
 * author : embedfire
 * date : 2019-11-26
 * version : A001
 */

 /dts-v1/;
 /plugin/;
#include "imx6ul-pinfunc.h"

 / {
     fragment@0 {
         target = <&i2c1>;
         __overlay__ { 
            clock-frequency = <100000>;
	        pinctrl-names = "default";
	        pinctrl-0 = <&pinctrl_i2c1>;
	        status = "okay";

	        i2c_mpu6050@68 {
	        	compatible = "fire,i2c_mpu6050";
	        	reg = <0x68>;
	        	status = "okay";
	        };        
         };
     };

     fragment@1 {
         target = <&iomuxc>;
         __overlay__ { 
        pinctrl_i2c1: i2c1grp {
        		fsl,pins = <
        			MX6UL_PAD_UART4_TX_DATA__I2C1_SCL 0x4001b8b0
        			MX6UL_PAD_UART4_RX_DATA__I2C1_SDA 0x4001b8b0
        		>;
        	};     
         };
     };

 };
